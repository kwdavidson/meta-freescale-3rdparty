## conf/machine/imx8mm-cgt-sx8m.conf
```bitbake
#@TYPE: Machine
#@NAME: SX8M
#@SOC: i.MX8MM
#@DESCRIPTION: Machine configuration for congatec SX8M board
#@MAINTAINER: Lukas Posadka <lukas.posadka@congatec.com>

MACHINEOVERRIDES =. "mx8:mx8m:mx8mm:sx8m:"

require conf/machine/include/imx-base.inc
require conf/machine/include/tune-cortexa53.inc

MACHINE_FEATURES += " pci"
#MACHINE_FEATURES += " optee"

#KBUILD_DEFCONFIG_imx8mm-cgt-sx8m ?= "sx8m_defconfig"
#KBUILD_DEFCONFIG_imx8mm-cgt-sx8m ?= "cgtsx8x_defconfig"

#PREFERRED_PROVIDER_virtual/kernel_imx8mm-cgt-sx8m = "linux-congatec-sx8m"
PREFERRED_PROVIDER_virtual/kernel_imx8mm-cgt-sx8m = "linux-imx"
KERNEL_DEVICETREE = "congatec/imx8mm-cgtsx8m.dtb \
                     congatec/imx8mm-cgtsx8m-dp.dtb \
                     congatec/imx8mm-cgtsx8m-dp-1280x1024.dtb \
		     congatec/imx8mm-cgtsx8m-800x600.dtb \
		     congatec/imx8mm-cgtsx8m-1920x1080-2ch.dtb \
		     congatec/imx8mm-cgtsx8m-1024x768-JEIDA.dtb"

PREFERRED_PROVIDER_virtual/bootloader_imx8mm-cgt-sx8m = "u-boot-congatec-sx8m"
UBOOT_DTB_NAME = "imx8mm-cgtsx8m.dtb"

UBOOT_CONFIG ??= "sd"
UBOOT_CONFIG[sd] = "cgtsx8m_defconfig"
UBOOT_CONFIG[fspi] = "cgtsx8m_fspi_defconfig"
UBOOT_CONFIG[mfgtool] = "cgtsx8m_defconfig"
SPL_BINARY = "spl/u-boot-spl.bin"

SOC_FAMILY = "mx8m"
IMX_BOOT_SOC_TARGET = "iMX8MM"

# Set ATF platform name
ATF_PLATFORM = "imx8mm"

# Set DDR FIRMWARE
DDR_FIRMWARE_NAME = "\
	lpddr4_pmu_train_1d_imem.bin \
	lpddr4_pmu_train_1d_dmem.bin \
	lpddr4_pmu_train_2d_imem.bin \
	lpddr4_pmu_train_2d_dmem.bin \
"

# wic support
WKS_FILE = "imx-uboot-spl-bootpart.wks.in"

# Set imx-mkimage boot target
IMXBOOT_TARGETS = "${@bb.utils.contains('UBOOT_CONFIG', 'fspi', 'flash_sx8m_flexspi', 'flash_sx8m', d)}"

# Set Serial console
SERIAL_CONSOLES = "115200;ttymxc1"

IMAGE_BOOTLOADER = "imx-boot"

LOADADDR = ""
UBOOT_SUFFIX = "bin"
UBOOT_MAKE_TARGET = ""
IMX_BOOT_SEEK = "33"

OPTEE_BIN_EXT = "8mm"

# Add additional firmware
MACHINE_FIRMWARE_append = " linux-firmware-ath10k"
```
